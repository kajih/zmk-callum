#include "callum.h"
#include "../includes/defines.h"
#include <behaviors.dtsi>

/* 
 * One-Shot Modifiers (Simple Hold-Tap)
 * Tap = Sticky Modifier (active until next keypress)
 * Hold = Standard Modifier (momentary)
 */

#define OLSHFT &osm LSHFT LSHFT
#define OLCTRL &osm LCTRL LCTRL
#define OLALT  &osm LALT  LALT
#define OLGUI  &osm LGUI  LGUI
#define ORSHFT &osm RSHFT RSHFT
#define ORCTRL &osm RCTRL RCTRL
#define ORALT  &osm RALT  RALT
#define ORGUI  &osm RGUI  RGUI

/ {
  behaviors {

    // --- Sticky wrapper: quick-release + timeout ---
    skq: sk_skq {
      compatible = "zmk,behavior-sticky-key";
      #binding-cells = <1>;
      bindings = <&kp>;
      release-after-ms = <1500>;
      quick-release;
      ignore-modifiers;
    };

    // --- HOLD-TAP: Hold = KP (Mod), Tap = Sticky (Mod) ---
    osm: ht_osm {
      compatible = "zmk,behavior-hold-tap";
      #binding-cells = <2>;
      tapping-term-ms = <200>;
      flavor = "hold-preferred";
      bindings = <&kp>, <&skq>;
    };

  };
};
